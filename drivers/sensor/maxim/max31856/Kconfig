## drivers/sensor/maxim/max31856/Kconfig
```kconfig
# MAX31865 temperature sensor configuration options

# Copyright (c) 2022 HAW Hamburg FTZ-DIWIP
# SPDX-License-Identifier: Apache-2.0

config MAX31856
	bool "MAX31856 Temperature Sensor"
	default y
	depends on DT_HAS_MAXIM_MAX31856_ENABLED
	select SPI
	help
	  Enable the driver for Maxim MAX31856 SPI Temperature Sensors.
```

## dts/bindings/sensor/maxim,max31856.yaml
```yaml
# Copyright (c) 2022, HAW Hamburg FTZ-DIWIP
# SPDX-License-Identifier: Apache-2.0


description: |
  Maxim MAX31856 SPI Thermocouple Temperature Sensor.
  Find the datasheet here:
  https://www.analog.com/media/en/technical-documentation/data-sheets/max31856.pdf

compatible: "maxim,max31856"

include: [sensor-device.yaml, spi-device.yaml]

properties:

  conversion-mode:
    type: boolean
    description: Conversions take place every 100ms

  one-shot:
    type: boolean
    description: Conversions take place when requested

  cold-junction:
    type: boolean
    description: Enable cold junction sensor

  thermocouple-type:
    type: int
    default: 0b0011
    description: Check datasheet for this value

  averaging-mode:
    type: int
    default: 0b0000
    description: Check datasheet for this value

  fault-interrupt-mode:
    type: boolean
    description: When disabled fault bit works in comparator mode, when enabled the fault bit has to be cleared manually

  filter-50hz:
    type: boolean

  fault-mask:
    type: int
    default: 0b00111111
    description: Check datasheet for this value

  cj-high-fault:
    type: int
    default: 0x7F

  cj-low-fault:
    type: int
    default: 0xC0

  lt-high-fault:
    type: int
    default: 0x7FFF

  lt-low-fault:
    type: int
    default: 0x8000

  cj-offset:
    type: int
    default: 0

  fault-gpios:
    type: phandle-array

  drdy-gpios:
    type: phandle-array
```
